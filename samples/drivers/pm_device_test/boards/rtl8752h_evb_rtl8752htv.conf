## samples/drivers/pm_device_test/boards/rtl8752h_evb_rtl8752htv.conf
```kconfig
# Copyright (c) 2026, Realtek Semiconductor Corporation
# SPDX-License-Identifier: Apache-2.0

CONFIG_SHELL=y
CONFIG_LOG=y
CONFIG_LOG_PRINTK=y
CONFIG_LOG_MODE_DEFERRED=y
CONFIG_LOG_PROCESS_TRIGGER_THRESHOLD=1

CONFIG_HEAP_MEM_POOL_SIZE=1048

CONFIG_PM=y
CONFIG_PM_DEVICE=y
CONFIG_PM_DEVICE_RUNTIME=n

CONFIG_SERIAL=y
CONFIG_UART_BEE_KEEP_ACTIVE_TIMEOUT_MSEC=1000

CONFIG_GPIO=y
CONFIG_GPIO_LOG_LEVEL_ERR=y
CONFIG_DMA=y
CONFIG_COUNTER=y
CONFIG_PWM=y
CONFIG_SPI=y
CONFIG_RTC=y
CONFIG_I2C=y
CONFIG_RTC_BEE=y
CONFIG_RTC_ALARM=y
CONFIG_RTC_UPDATE=y
CONFIG_SENSOR=y
CONFIG_ADC=y
CONFIG_ADC_ASYNC=y
CONFIG_INPUT=y
CONFIG_INPUT_EVENT_DUMP=y
CONFIG_INPUT_BEE_KEYSCAN=y
CONFIG_BEE_INPUT_KEYSCAN_AUTOSCAN_MODE=n

CONFIG_LOG_PROCESS_TRIGGER_THRESHOLD=1
```

## samples/drivers/pm_device_test/boards/rtl8762gn_evb.conf
```kconfig
CONFIG_HEAP_MEM_POOL_SIZE=1024
CONFIG_SHELL=y
CONFIG_PM=y
CONFIG_PM_DEVICE=y
CONFIG_LOG=y
CONFIG_LOG_PRINTK=y
CONFIG_LOG_MODE_DEFERRED=y
CONFIG_SERIAL=y
CONFIG_UART_ASYNC_API=y
CONFIG_UART_RTL87X2G_KEEP_ACTIVE_AFTER_RX_WAKEUP=y
CONFIG_UART_RTL87X2G_KEEP_ACTIVE_MSEC=0

CONFIG_GPIO=y
CONFIG_GPIO_LOG_LEVEL_ERR=y
CONFIG_DMA=y
CONFIG_COUNTER=y
CONFIG_PWM=y
CONFIG_SPI=y
CONFIG_I2C=y
CONFIG_I2C_SHELL=y
CONFIG_I2C_RTL87X2G_BUS_RECOVERY=y
CONFIG_RTC=y
CONFIG_RTC_RTL87X2G=y
CONFIG_RTC_ALARM=y
CONFIG_RTC_UPDATE=y
CONFIG_SENSOR=y
CONFIG_ADC=y
CONFIG_ADC_ASYNC=y
CONFIG_RTL87X2G_KEYSCAN_AUTOSCAN_MODE=n
CONFIG_RTL87X2G_KEYSCAN_MAX_ROW_SIZE=2
CONFIG_RTL87X2G_KEYSCAN_MAX_COL_SIZE=2
CONFIG_BT=n

CONFIG_LOG_PROCESS_TRIGGER_THRESHOLD=1
```

## samples/zephyr/drivers/usb/hid-mouse/testcase.yaml
```yaml
# Copyright (c) 2026 Realtek Semiconductor Corp.
# SPDX-License-Identifier: Apache-2.0

tests:
  boards.realtek.hid_mouse:
    tags: usb hid boot remote-wakeup
    build_only: true
    platform_allow:
      - rtl87x2j_evb/rtl8762jth
      - rtl87x2g_evb_a/rtl8762gku
    integration_platforms:
      - rtl87x2j_evb/rtl8762jth
```
