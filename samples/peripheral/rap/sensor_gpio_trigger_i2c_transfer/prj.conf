## CMakeLists.txt
```
# Copyright (c) 2026 Realtek Semiconductor Corp.
# SPDX-License-Identifier: Apache-2.0

cmake_minimum_required(VERSION 3.20.0)
find_package(Zephyr REQUIRED HINTS $ENV{ZEPHYR_BASE})
project(sensor_gpio_trigger_i2c_transfer)

target_include_directories(app PRIVATE ${CMAKE_CURRENT_SOURCE_DIR}/src)
target_sources(app PRIVATE ${CMAKE_CURRENT_SOURCE_DIR}/src/lis3dh_driver.c)
target_sources(app PRIVATE ${CMAKE_CURRENT_SOURCE_DIR}/src/sensor_gpio_trigger_i2c_transfer.c)
```

## prj.conf
```kconfig
# Copyright (c) 2026 Realtek Semiconductor Corp.
# SPDX-License-Identifier: Apache-2.0
CONFIG_REALTEK_BEE_PINMUX=y
CONFIG_REALTEK_BEE_RCC=y
CONFIG_REALTEK_BEE_RAP=y
CONFIG_REALTEK_BEE_TIMER=y
CONFIG_REALTEK_BEE_GPIO=y
CONFIG_REALTEK_BEE_DMA=y
CONFIG_REALTEK_BEE_I2C=y
CONFIG_REALTEK_BEE_RTC=y
```

## src/lis3dh_driver.c
```c
/*
 * Copyright (c) 2026, Realtek Semiconductor Corporation
 *
 * SPDX-License-Identifier: LicenseRef-Realtek-5-Clause
 */

/* Includes ------------------------------------------------------------------*/
#include "lis3dh_driver.h"

/* Defines -------------------------------------------------------------------*/

/* Functions -----------------------------------------------------------------*/

/**
 * \brief  Internal helper: Write Register.
 */
static void lis3dh_reg_write(I2C_TypeDef *i2c_dev, uint8_t reg, uint8_t value)
{
    /* Disable DMA Mode during configuration */
    I2C_DMACmd(i2c_dev, I2C_DMA_REQ_RX, DISABLE);

    /* Use I2C Wrapper Mode */
    I2C_WrapperModeCmd(i2c_dev, ENABLE);
    I2C_WrapperSetTransMode(i2c_dev, I2C_WRAPPER_TRANS_MODE_WRITE);
    I2C_WrapperClearTxFIFO(i2c_dev);

    /*
     * SUB[7] is set as 0 in this API.
     * SUB[7] is used to enable address auto increment.
     * If the SUB[7] equals to 1, the SUB[0:6] (register address) is
     * automatically increased to allow multiple data read/writes.
     */

    I2C_WrapperSetWriteNum(i2c_dev, 2);
    I2C_WrapperSetWriteData(i2c_dev, &reg, 1);
    I2C_WrapperSetWriteData(i2c_dev, &value, 1);

    /* Start I2C transfer */
    I2C_ActionTrigger(i2c_dev, I2C_ACTION_START);

    /* Wait for I2C Transfer Done */
    while (I2C_GetFlagState(i2c_dev, I2C_FLAG_ACTIVITY)) {;}
}

/**
 * \brief  Internal helper: Read Register.
 */
static uint8_t lis3dh_reg_read(I2C_TypeDef *i2c_dev, uint8_t reg)
{
    /* Disable DMA Mode */
    I2C_DMACmd(i2c_dev, I2C_DMA_REQ_RX, DISABLE);

    /* Use I2C Wrapper Mode */
    I2C_WrapperModeCmd(i2c_dev, ENABLE);
    I2C_WrapperSetTransMode(i2c_dev, I2C_WRAPPER_TRANS_MODE_REPEAT_READ);
    I2C_WrapperClearTxFIFO(i2c_dev);

    /*
     * SUB[7] is set as 0 in this API.
     * SUB[7] is used to enable address auto increment.
     * If the SUB[7] equals to 1, the SUB[0:6] (register address) is
     * automatically increased to allow multiple data read/writes.
     */

    I2C_WrapperSetWriteNum(i2c_dev, 1);
    I2C_WrapperSetWriteData(i2c_dev, &reg, 1);
    I2C_WrapperSetReadNum(i2c_dev, 1);

    /* Start I2C transfer */
    I2C_ActionTrigger(i2c_dev, I2C_ACTION_START);

    /* Wait for I2C Transfer Done */
    while (I2C_GetFlagState(i2c_dev, I2C_FLAG_ACTIVITY)) {;}

    /* Receive data */
    return I2C_WrapperReceiveData(i2c_dev);
}

/**
 * \brief  Configure I2C for Burst Read.
 *         Note: Does not trigger START, waits for external signal (RAP/DMA).
 */
void lis3dh_config_burst_read(I2C_TypeDef *i2c_dev, uint8_t reg, uint32_t len)
{
    /* Enable RX DMA Request */
    I2C_DMACmd(i2c_dev, I2C_DMA_REQ_RX, ENABLE);

    /* Use I2C Wrapper Mode */
    I2C_WrapperModeCmd(i2c_dev, ENABLE);
    I2C_WrapperSetTransMode(i2c_dev, I2C_WRAPPER_TRANS_MODE_REPEAT_READ);
    I2C_WrapperClearTxFIFO(i2c_dev);

    /* Prepare Address (reg should include Auto-Increment Bit if needed) */
    I2C_WrapperSetWriteNum(i2c_dev, 1);
    I2C_WrapperSetWriteData(i2c_dev, &reg, 1);

    /* Set expected read length */
    I2C_WrapperSetReadNum(i2c_dev, len);
}

uint8_t lis3dh_read_id(I2C_TypeDef *i2c_dev)
{
    return lis3dh_reg_read(i2c_dev, LIS3DH_REG_WHO_AM_I);
}

void lis3dh_config_fifo(I2C_TypeDef *i2c_dev, bool enable, uint8_t threshold)
{
    if (enable)
    {
        /* Enable FIFO, Stream Mode, Set Threshold */
        uint8_t fifo_ctrl_reg = lis3dh_reg_read(i2c_dev, LIS3DH_REG_FIFO_CTRL_REG);
        fifo_ctrl_reg = (fifo_ctrl_reg & ~0xC0) | (LIS3DH_FIFO_MODE_STREAM_FIFO << 6);
        fifo_ctrl_reg &= ~BIT5; /* Clear TR bit */
        fifo_ctrl_reg |= (threshold & 0x1F);
        lis3dh_reg_write(i2c_dev, LIS3DH_REG_FIFO_CTRL_REG, fifo_ctrl_reg);

        /* Enable FIFO in Ctrl Reg 5 */
        uint8_t ctrl_reg5 = lis3dh_reg_read(i2c_dev, LIS3DH_REG_CTRL_REG5);
        ctrl_reg5 |= BIT6;
        lis3dh_reg_write(i2c_dev, LIS3DH_REG_CTRL_REG5, ctrl_reg5);
    }
    else
    {
        /* Bypass Mode */
        uint8_t fifo_ctrl_reg = lis3dh_reg_read(i2c_dev, LIS3DH_REG_FIFO_CTRL_REG);
        fifo_ctrl_reg = (fifo_ctrl_reg & ~0xC0) | (LIS3DH_FIFO_MODE_BYPASS << 6);
        lis3dh_reg_write(i2c_dev, LIS3DH_REG_FIFO_CTRL_REG, fifo_ctrl_reg);

        /* Disable FIFO in Ctrl Reg 5 */
        uint8_t ctrl_reg5 = lis3dh_reg_read(i2c_dev, LIS3DH_REG_CTRL_REG5);
        ctrl_reg5 &= ~BIT6;
        lis3dh_reg_write(i2c_dev, LIS3DH_REG_CTRL_REG5, ctrl_reg5);
    }
}

void lis3dh_config_interrupt(I2C_TypeDef *i2c_dev)
{
    /********************* INT1 CFG *********************/
    /*
     * INT1 CFG:
     * 0x30[6:7] AOI-6D is set as '10' means AND combination of interrupt events
     *  - AOI: 1 ~ AND, 0 ~ OR
     *  - 6D : 1  ~Direction Source, 0 ~ Interrupt Source
     * 0x30[0:5] Enable interrupt generation on X(H/L) Y(H/L) Z(H/L)
     */
    lis3dh_reg_write(i2c_dev, LIS3DH_REG_INT1_CFG, 0xBF);

    /*
     * INT1 THS:
     * 0x32[0:6] Interrupt threshold support 2^7=128 prescaler of max range.
     */
    lis3dh_reg_write(i2c_dev, LIS3DH_REG_INT1_THS, 0x10); /* 1/8 range */

    /*
     * INT1 DURAION:
     * 0x33[0:6] Interrupt Duration.
     */
    lis3dh_reg_write(i2c_dev, LIS3DH_REG_INT1_DURATION, 0x01); /* 1 * 1/50 s = 20ms */

    /********************* Click CFG *********************/
    /*
     * CLICK CFG:
     * 0x38[0:5] Enable interrupt single/double click on X(H/L) Y(H/L) Z(H/L)
     */
    lis3dh_reg_write(i2c_dev, LIS3DH_REG_CLICK_CFG, 0x15);/* 0x2A is for Double Click */

    /*
     * CLICK SRC:
     * 0x39[0:6] Enable interrupt source
     * - 0x39[0]: X click detection
     * - 0x39[1]: Y click detection
     * - 0x39[2]: Z click detection
     * - 0x39[3]: Click Sign
     * - 0x39[4]: Single Click
     * - 0x39[5]: Double Click
     * - 0x39[6]: Interrupt Active
     */
    //lis3dh_reg_write(i2c_dev, LIS3DH_REG_CLICK_SRC, 0x17);

    /*
     * CLICK THS:
     * 0x3A[0:6] Click thresold.
     * This sets the threshold where the click detection process is activated.
     */
    lis3dh_reg_write(i2c_dev, LIS3DH_REG_CLICK_THS, 0x0A); /* 1/16 range */

    /*
     * TIME LIMIT:
     * 0x3B[0:6] Click time limit
     * Time acceleration has to fall below threshold for a valid click.
     */
    lis3dh_reg_write(i2c_dev, LIS3DH_REG_TIME_LIMIT, 0x08); /* 8 * 1/50 s = 160ms */

    /*
     * TIME LATENCY:
     * 0x3C[0:7] Click time latency
     * hold-off time before allowing detection after click event
     */
    lis3dh_reg_write(i2c_dev, LIS3DH_REG_TIME_LATENCY, 0x08); /* 8 * 1/50 s = 160ms */

    /*
     * TIME WINDOWN:
     * 0x3D[0:7] Click time window
     * hold-off time before allowing detection after click event
     */
    lis3dh_reg_write(i2c_dev, LIS3DH_REG_TIME_WINDOW, 0x10); /* 16 * 1/50 s = 320ms */

    /********************* Basic CFG *********************/
    /* Clear Latch Interrupt and 4 Direction Detection */
    uint8_t ctrl_reg5 = lis3dh_reg_read(i2c_dev, LIS3DH_REG_CTRL_REG5);
    ctrl_reg5 &= 0xF3;
    ctrl_reg5 &= ~0x08;
    lis3dh_reg_write(i2c_dev, LIS3DH_REG_CTRL_REG5, ctrl_reg5);

    /*
     * CTRL REG3:
     * 0x22[0:7] Interrupt Configure
     * - 0x22[0]: -
     * - 0x22[1]: FIFO Overrun on INT1
     * - 0x22[2]: FIFO Watermack on INT1
     * - 0x22[3]: 3 2 1 DATA ??
     * - 0x22[4]: X Y Z DATA (Data Ready) on INT1
     * - 0x22[5]: IA2 Interrupt on INT1
     * - 0x22[6]: IA1 Interrupt on INT1
     * - 0x22[7]: Click Interrupt on INT1
     */
    uint8_t ctrl_reg3 = 0x60; /* AOI1 | AOI2 */
    lis3dh_reg_write(i2c_dev, LIS3DH_REG_CTRL_REG3, ctrl_reg3);

    /*
     * CTRL REG6:
     * 0x25[0:7] Interrupt Configure
     * - 0x25[0]: -
     * - 0x25[1]: INT1 and INT2 pin polarity
     * - 0x25[2]: -
     * - 0x25[3]: Activity Interrupt on INT2
     * - 0x25[4]: Boot on INT2
     * - 0x25[5]: IA2 Interrupt on INT2
     * - 0x25[6]: IA1 Interrupt on INT2
     * - 0x25[7]: Click Interrupt on INT2
     */
    uint8_t ctrl_reg6 = 0x80; /* Click */
    lis3dh_reg_write(i2c_dev, LIS3DH_REG_CTRL_REG6, ctrl_reg6);

    /* Overwrite CTRL REG3 */
    ctrl_reg3 = LIS3DH_I1_WTM;
    lis3dh_reg_write(i2c_dev, LIS3DH_REG_CTRL_REG3, ctrl_reg3);
}

void lis3dh_init(I2C_TypeDef *i2c_dev)
{
    /*
     * CTRL REG1:
     * 0x20[0:7] Basic Configure
     * - 0x20[0]: X-axis enable
     * - 0x20[1]: Y-axis enable
     * - 0x20[2]: X-axis enable
     * - 0x20[3]: Low Power Mode enable
     * - 0x20[4~7]: Data Rate Selection
     *
     * Enable X Y Z Axis and config Data Rate as 50Hz
     */
    uint8_t ctrl_reg1 = (LIS3DH_DATA_RATE_50_HZ << 4) | 0x07;
    lis3dh_reg_write(i2c_dev, LIS3DH_REG_CTRL_REG1, ctrl_reg1);

    /*
     * CTRL REG4:
     * 0x23[0:7] Basic Configure
     * - 0x23[0]: SPI serial interface mode selection
     * - 0x23[1:2]: Self-test enable.
     * - 0x23[3]: High-resolution output mode
     * - 0x23[4:5]: Full-scale selection(00: 2g; 01: 4g; 10: 8g; 11: 16g)
     * - 0x23[6]: Big/little endian data selection.
     * - 0x23[7]: Block data update
     *
     * Use +/- 2g scale, High-resolution, Block data update
     */
    uint8_t ctrl_reg4 = (0x00 << 4) | 0x80 | 0x08;
    lis3dh_reg_write(i2c_dev, LIS3DH_REG_CTRL_REG4, ctrl_reg4);

    /* Disable FIFO Mode Firstly */
    lis3dh_config_fifo(i2c_dev, DISABLE, 0);
}
```

## src/lis3dh_driver.h
```c
/*
 * Copyright (c) 2026, Realtek Semiconductor Corporation
 *
 * SPDX-License-Identifier: LicenseRef-Realtek-5-Clause
 */

/* Includes ------------------------------------------------------------------*/
#ifndef LIS3DH_H
#define LIS3DH_H

#include <stdint.h>
#include <stdbool.h>
#include "rtl_i2c.h"

/* Defines -------------------------------------------------------------------*/

/* LI23DH Parameters */
#define LIS3DH_CHIP_ID                  (0x33)
#define LIS3DH_I2C_ADDRESS              (0x18)

#define LIS3DH_INT1                     (1)
#define LIS3DH_I2C_MS_BIT               (BIT7)

/* LI23DH Comands */
#define LIS3DH_REG_STATUS_REG_AUX       (0x07)
#define LIS3DH_REG_OUT_ADC1_L           (0x08)
#define LIS3DH_REG_OUT_ADC1_H           (0x09)
#define LIS3DH_REG_OUT_ADC2_L           (0x0A)
#define LIS3DH_REG_OUT_ADC2_H           (0x0B)
#define LIS3DH_REG_OUT_ADC3_L           (0x0C)
#define LIS3DH_REG_OUT_ADC3_H           (0x0D)
#define LIS3DH_REG_WHO_AM_I             (0x0F)
#define LIS3DH_REG_CTRL_REG0            (0x1E)
#define LIS3DH_REG_TEMP_CFG_REG         (0x1F)
#define LIS3DH_REG_CTRL_REG1            (0x20)
#define LIS3DH_REG_CTRL_REG2            (0x21)
#define LIS3DH_REG_CTRL_REG3            (0x22)
#define LIS3DH_REG_CTRL_REG4            (0x23)
#define LIS3DH_REG_CTRL_REG5            (0x24)
#define LIS3DH_REG_CTRL_REG6            (0x25)
#define LIS3DH_REG_REFERENCE            (0x26)
#define LIS3DH_REG_STATUS_REG           (0x27)
#define LIS3DH_REG_OUT_X_L              (0x28)
#define LIS3DH_REG_OUT_X_H              (0x29)
#define LIS3DH_REG_OUT_Y_L              (0x2A)
#define LIS3DH_REG_OUT_Y_H              (0x2B)
#define LIS3DH_REG_OUT_Z_L              (0x2C)
#define LIS3DH_REG_OUT_Z_H              (0x2D)
#define LIS3DH_REG_FIFO_CTRL_REG        (0x2E)
#define LIS3DH_REG_FIFO_SRC_REG         (0x2F)
#define LIS3DH_REG_INT1_CFG             (0x30)
#define LIS3DH_REG_INT1_SRC             (0x31)
#define LIS3DH_REG_INT1_THS             (0x32)
#define LIS3DH_REG_INT1_DURATION        (0x33)
#define LIS3DH_REG_INT2_CFG             (0x34)
#define LIS3DH_REG_INT2_SRC             (0x35)
#define LIS3DH_REG_INT2_THS             (0x36)
#define LIS3DH_REG_INT2_DURATION        (0x37)
#define LIS3DH_REG_CLICK_CFG            (0x38)
#define LIS3DH_REG_CLICK_SRC            (0x39)
#define LIS3DH_REG_CLICK_THS            (0x3A)
#define LIS3DH_REG_TIME_LIMIT           (0x3B)
#define LIS3DH_REG_TIME_LATENCY         (0x3C)
#define LIS3DH_REG_TIME_WINDOW          (0x3D)
#define LIS3DH_REG_ACT_THS              (0x3E)
#define LIS3DH_REG_ACT_DUR              (0x3F)

/* LI23DH FIFO Mode */
#define LIS3DH_FIFO_MODE_BYPASS         (0)
#define LIS3DH_FIFO_MODE_FIFO           (1)
#define LIS3DH_FIFO_MODE_STREAM         (2)
#define LIS3DH_FIFO_MODE_STREAM_FIFO    (3)

/* LI23DH I1 Parameters */
#define LIS3DH_I1_CLICK                 (BIT7)
#define LIS3DH_I1_IA1                   (BIT6)
#define LIS3DH_I1_IA2                   (BIT5)
#define LIS3DH_I1_ZYXDA                 (BIT4)
#define LIS3DH_I1_321DA                 (BIT3)
#define LIS3DH_I1_WTM                   (BIT2)
#define LIS3DH_I1_OVERRUN               (BIT1)

/* LI23DH Data Rate Parameters */
#define LIS3DH_DATA_RATE_5376_HZ        (9)
#define LIS3DH_DATA_RATE_1600_HZ        (8)
#define LIS3DH_DATA_RATE_400_HZ         (7)
#define LIS3DH_DATA_RATE_200_HZ         (6)
#define LIS3DH_DATA_RATE_100_HZ         (5)
#define LIS3DH_DATA_RATE_50_HZ          (4)
#define LIS3DH_DATA_RATE_25_HZ          (3)
#define LIS3DH_DATA_RATE_10_HZ          (2)
#define LIS3DH_DATA_RATE_1_HZ           (1)
#define LIS3DH_DATA_RATE_POWER_DOWN     (0)

/* Functions -----------------------------------------------------------------*/

/**
 * \brief  Initialize LIS3DH (ODR, Range, BDU).
 * \param  i2c_dev: I2C Peripheral instance.
 */
void lis3dh_init(I2C_TypeDef *i2c_dev);

/**
 * \brief  Read Device ID.
 * \return ID (0x33).
 */
uint8_t lis3dh_read_id(I2C_TypeDef *i2c_dev);

/**
 * \brief  Configure Sensor Interrupts (Threshold, Click, etc.).
 * \param  i2c_dev: I2C Peripheral instance.
 */
void lis3dh_config_interrupt(I2C_TypeDef *i2c_dev);

/**
 * \brief  Configure FIFO mode.
 */
void lis3dh_config_fifo(I2C_TypeDef *i2c_dev, bool enable, uint8_t threshold);

/**
 * \brief  Configure Burst Read.
 *         Configures I2C Wrapper for repeated reading.
 */
void lis3dh_config_burst_read(I2C_TypeDef *i2c_dev, uint8_t reg, uint32_t len);

#endif /* LIS3DH_H */
```

## src/sensor_gpio_trigger_i2c_transfer.c
```c
/*
 * Copyright (c) 2026, Realtek Semiconductor Corporation
 *
 * SPDX-License-Identifier: LicenseRef-Realtek-5-Clause
 */

/*============================================================================*
 *                              Header Files
 *============================================================================*/
#include <stdlib.h>
#include <stdint.h>
#include "rtl_pinmux.h"
#include "rtl_rcc.h"
#include "rtl_nvic.h"
#include "rtl_rap.h"
#include "rtl_timer.h"
#include "rtl_gpio.h"
#include "rtl_dma.h"
#include "rtl_i2c.h"
#include "rtl_rtc.h"
#include "utils.h"
#include "log_core.h"
#include "lis3dh_driver.h"

/* Defines ------------------------------------------------------------*/
/* GPIO configuration which can be modified based on requirements */
#define INPUT_PIN                           P0_0
#define GPIO_IN_PIN                         GPIO_GetPinBit(INPUT_PIN)
#define GPIO_IN_PORT                        GPIO_GetPort(INPUT_PIN)
#define GPIO_IN_IRQN                        GPIOA0_IRQn
/* RAP Configuration */
#define GPIO_IN_EVENT_IN                    RAP_EVENT_GPIOA(0)

/* I2C configuration which can be modified based on requirements */
/* Configure I2C Master parameters */
#define I2C_MASTER                          I2C0
#define I2C_MASTER_CLOCK                    I2C0_CLOCK
#define I2C_MASTER_SCL_PIN                  P4_0
#define I2C_MASTER_SDA_PIN                  P4_1
#define I2C_MASTER_SCL_PINMUX               I2C0_CLK
#define I2C_MASTER_SDA_PINMUX               I2C0_DAT

#define LIS3DH_I2C_SA0_PIN                  P4_2
#define LIS3DH_I2C_CS_PIN                   P4_3

/* RAP configuration */
#define I2C_MASTER_EVENT_TRANSFER_START     RAP_EVENT_I2C_STARTED(0)
#define I2C_MASTER_ACTION_TRANSFER_START    RAP_ACTION_I2C_START(0)

/* DMA configuration which can be modified based on requirements */
/* Master RX DMA (Receives data from Slave) */
#define I2C_MASTER_RX_DMA_CHANNEL           DMA_CH4
#define I2C_MASTER_RX_DMA_CHANNEL_NUM       DMA_CH_NUM4
#define I2C_MASTER_RX_DMA_IRQN              DMA0_CH4_IRQn
#define I2C_MASTER_RX_DMA_HANDSHAKE         DMA_HANDSHAKE_I2C0_RX
/* RAP configuration */
#define I2C_MASTER_RX_DMA_ACTION_START      RAP_ACTION_DMA_CHANNEL_EN(4)

/*
 * 3 Axis includes X, Y, Z.
 * 12-bit data out per Axis in high resolution mode (12-bits).
 */
#define BYTES_PER_SAMPLE                    (3 * 2)

/*
 * Number of sets to read in one trigger.
 * Original logic: 3 sets * 6 bytes = 18 bytes per trigger.
 */
#define TRIGGER_SAMPLE_NUM                  (3)

/* DMA Block Counter (Interrupt triggers after this many blocks) */
#define DMA_BLOCK_COUNTER_NUM               (10)

/* Globals ------------------------------------------------------------------*/
static uint8_t i2c_rx_buffer[BYTES_PER_SAMPLE * TRIGGER_SAMPLE_NUM * DMA_BLOCK_COUNTER_NUM] = {0};
volatile bool is_receive_done = false;

/* Functions ----------------------------------------------------------------*/
/**
 * \brief  DMA Interrupt Service Routine (ISR) prototype for Master RX.
 */
static void I2C_MASTER_RX_DMA_Handler(void);

/**
 * \brief  GPIO Interrupt Service Routine (ISR) prototype.
 */
static void GPIO_Pin_Handler(void);

/**
 * \brief  Initializes pad and pinmux settings.
 */
static void board_gpio_init(void)
{
    Pad_Config(INPUT_PIN, PAD_PINMUX_MODE, PAD_IS_PWRON, PAD_PULL_DOWN, PAD_OUT_DISABLE, PAD_OUT_HIGH);
    Pinmux_Config(INPUT_PIN, DWGPIO);
}

/**
 * \brief  Initializes GPIO peripheral and Interrupts.
 */
static void driver_gpio_init(void)
{
    /* Enable GPIO clock */
    RCC_ClockCmd(GPIOA_CLOCK, ENABLE);

    /* Configure GPIO parameters as input mode */
    GPIO_InitTypeDef GPIO_InitStruct;
    GPIO_StructInit(&GPIO_InitStruct);
    GPIO_InitStruct.GPIO_Pin        = GPIO_IN_PIN;
    GPIO_InitStruct.GPIO_Dir        = GPIO_DIR_IN;
    GPIO_InitStruct.GPIO_INTEventEn = ENABLE;
    GPIO_InitStruct.GPIO_Trigger    = GPIO_TRIGGER_EDGE;
    GPIO_InitStruct.GPIO_Polarity   = GPIO_POLARITY_ACTIVE_HIGH;
    GPIO_Init(GPIO_IN_PORT, &GPIO_InitStruct);

    /* When the trigger conditions are met, the system supports the simultaneous
     * triggering of RAP events and interrupts. Users can enable the interrupt
     * function according to their actual usage needs.
     * Set to 1 to activate the interrupt function.
     */
#if 0
    /* Update vector table with ISR */
    ram_vector_table_update(GPIO_IN_IRQN, GPIO_Pin_Handler);

    /* Configure NVIC */
    NVIC_InitTypeDef NVIC_InitStruct;
    NVIC_InitStruct.NVIC_IRQChannel         = GPIO_IN_IRQN;
    NVIC_InitStruct.NVIC_IRQChannelCmd      = ENABLE;
    NVIC_InitStruct.NVIC_IRQChannelPriority = 3;
    NVIC_Init(&NVIC_InitStruct);

    /* Enable interrupt */
    GPIO_MaskINTConfig(GPIO_IN_PORT, GPIO_IN_PIN, ENABLE);
    GPIO_INTConfig(GPIO_IN_PORT, GPIO_IN_PIN, ENABLE);

    GPIO_ClearINTPendingBit(GPIO_IN_PORT, GPIO_IN_PIN);
    GPIO_MaskINTConfig(GPIO_IN_PORT, GPIO_IN_PIN, DISABLE);
#endif
}

/**
 * \brief  Initialize I2C Master pad and pinmux settings.
 */
static void board_i2c_master_init(void)
{
    Pad_Config(I2C_MASTER_SCL_PIN, PAD_PINMUX_MODE, PAD_IS_PWRON, PAD_PULL_UP, PAD_OUT_ENABLE,
               PAD_OUT_HIGH);
    Pad_Config(I2C_MASTER_SDA_PIN, PAD_PINMUX_MODE, PAD_IS_PWRON, PAD_PULL_UP, PAD_OUT_ENABLE,
               PAD_OUT_HIGH);

    Pinmux_Config(I2C_MASTER_SCL_PIN, I2C_MASTER_SCL_PINMUX);
    Pinmux_Config(I2C_MASTER_SDA_PIN, I2C_MASTER_SDA_PINMUX);

    Pad_Config(LIS3DH_I2C_SA0_PIN, PAD_SW_MODE, PAD_IS_PWRON, PAD_PULL_DOWN, PAD_OUT_ENABLE,
               PAD_OUT_LOW);
    Pad_Config(LIS3DH_I2C_CS_PIN, PAD_SW_MODE, PAD_IS_PWRON, PAD_PULL_UP, PAD_OUT_ENABLE,
               PAD_OUT_HIGH);
}

/**
 * \brief  Initialize I2C Master peripheral.
 */
static void driver_i2c_master_init(void)
{
    /* Enable I2C Master clock */
    RCC_ClockCmd(I2C_MASTER_CLOCK, ENABLE);

    /* Configure I2C Master parameters */
    I2C_InitTypeDef I2C_InitStruct;
    I2C_StructInit(&I2C_InitStruct);
    I2C_InitStruct.I2C_ClockSpeed   = 400000;
    I2C_InitStruct.I2C_DeviceMode   = I2C_DEVICE_MODE_MASTER;
    I2C_InitStruct.I2C_AddressMode  = I2C_ADDRESS_MODE_7BIT;
    I2C_InitStruct.I2C_SlaveAddress = LIS3DH_I2C_ADDRESS;
    I2C_InitStruct.I2C_Ack          = ENABLE;
    I2C_InitStruct.I2C_RxDMAEn      = DISABLE;
    I2C_InitStruct.I2C_RxWaterlevel = 1;
    I2C_Init(I2C_MASTER, &I2C_InitStruct);

    /* Enable I2C */
    I2C_Cmd(I2C_MASTER, ENABLE);

    I2C_RAPModeCmd(I2C_MASTER, ENABLE);
}

/**
 * \brief  Initialize DMA Channel for Master RX.
 */
static void driver_dma_master_rx_init(void)
{
    /* Enable DMA clock */
    RCC_ClockCmd(DMA_CLOCK, ENABLE);

    /* Configure DMA parameters */
    DMA_InitTypeDef DMA_InitStruct;
    DMA_StructInit(&DMA_InitStruct);
    DMA_InitStruct.DMA_ChannelNum          = I2C_MASTER_RX_DMA_CHANNEL_NUM;
    DMA_InitStruct.DMA_Direction           = DMA_DIR_PERIPHERAL_TO_MEMORY;
    DMA_InitStruct.DMA_BufferSize          = 0; /* To be configured later */
    DMA_InitStruct.DMA_SourceInc           = DMA_SOURCE_FIX;
    DMA_InitStruct.DMA_DestinationInc      = DMA_DESTINATION_INC;
    DMA_InitStruct.DMA_SourceDataSize      = DMA_DATA_SIZE_BYTE;
    DMA_InitStruct.DMA_DestinationDataSize = DMA_DATA_SIZE_BYTE;
    DMA_InitStruct.DMA_SourceMsize         = DMA_MSIZE_1;
    DMA_InitStruct.DMA_DestinationMsize    = DMA_MSIZE_1;
    DMA_InitStruct.DMA_SourceAddr          = (uint32_t)(&(I2C_MASTER->IC_DATA_CMD));
    DMA_InitStruct.DMA_DestinationAddr     = (uint32_t)NULL;
    DMA_InitStruct.DMA_SourceHandshake     = I2C_MASTER_RX_DMA_HANDSHAKE;
    DMA_Init(I2C_MASTER_RX_DMA_CHANNEL, &DMA_InitStruct);

    /* Update vector table with ISR */
    ram_vector_table_update(I2C_MASTER_RX_DMA_IRQN, I2C_MASTER_RX_DMA_Handler);

    /* Configure NVIC */
    NVIC_InitTypeDef NVIC_InitStruct;
    NVIC_InitStruct.NVIC_IRQChannel         = I2C_MASTER_RX_DMA_IRQN;
    NVIC_InitStruct.NVIC_IRQChannelCmd      = ENABLE;
    NVIC_InitStruct.NVIC_IRQChannelPriority = 3;
    NVIC_Init(&NVIC_InitStruct);

    /* Enable DMA Block Counter interrupt */
    DMA_INTConfig(I2C_MASTER_RX_DMA_CHANNEL_NUM, DMA_INT_BLOCK_COUNTER, ENABLE);
}

/**
 * \brief  Main entry.
 */
int main(void)
{
    /* Enable Global Interrupts */
    __enable_irq();

    DBG_DIRECT("Start Sensor gpio trigger i2c transfer sample");

    /* Peripheral initialization */
    board_gpio_init();
    driver_gpio_init();
    board_i2c_master_init();
    driver_i2c_master_init();
    driver_dma_master_rx_init();

    /* Initialize Sensor */
    lis3dh_init(I2C_MASTER);

    /* Read ID */
    uint8_t id = lis3dh_read_id(I2C_MASTER);
    DBG_DIRECT("Sensor ID: 0x%02x", id);

    /* Configure Sensor FIFO (3 samples * 6 bytes = 18) & Interrupt */
    lis3dh_config_fifo(I2C_MASTER, ENABLE, TRIGGER_SAMPLE_NUM * BYTES_PER_SAMPLE);
    lis3dh_config_interrupt(I2C_MASTER);

    /* Configure RAP channel */
    uint8_t channel0, channel1;
    RAP_ChannelAllocate(&channel0);
    RAP_ChannelAllocate(&channel1);

    /* GPIO in event trigger I2C transfer start */
    RAP_EventRouteSet(GPIO_IN_EVENT_IN, channel0);
    RAP_ActionBindSet(I2C_MASTER_ACTION_TRANSFER_START, channel0);

    /* I2C transfer start event trigger DMA start */
    RAP_EventRouteSet(I2C_MASTER_EVENT_TRANSFER_START, channel1);
    RAP_ActionBindSet(I2C_MASTER_RX_DMA_ACTION_START, channel1);

    /*
     * Configure Burst Read Protocol
     * Tell I2C to read starting from OUT_X_L with Auto-Increment
     */
    uint8_t cmd = LIS3DH_REG_OUT_X_L | LIS3DH_I2C_MS_BIT;
    lis3dh_config_burst_read(I2C_MASTER, cmd, TRIGGER_SAMPLE_NUM * BYTES_PER_SAMPLE);

    /*
     * Configure DMA Transport
     * Buffer Size = 18 bytes, Block Counter = 10
     */
    DMA_SetBufferSize(I2C_MASTER_RX_DMA_CHANNEL, TRIGGER_SAMPLE_NUM * BYTES_PER_SAMPLE);
    DMA_SetDestinationAddress(I2C_MASTER_RX_DMA_CHANNEL, (uint32_t)(i2c_rx_buffer));
    DMA_SetBlockCounter(I2C_MASTER_RX_DMA_CHANNEL, DMA_BLOCK_COUNTER_NUM);
    DMA_ContDarCmd(I2C_MASTER_RX_DMA_CHANNEL, ENABLE);

    /* Enable RAP Mode */
    GPIO_RAPModeCmd(GPIO_IN_PORT, GPIO_IN_PIN, ENABLE);
    DMA_RAPModeCmd(I2C_MASTER_RX_DMA_CHANNEL, ENABLE);

    while (1)
    {
        /*
         * Check data reception status.
         * The 'is_receive_done' flag is set in the RX DMA ISR.
         * RX DMA Interrupt is triggered indicates a complete packet.
         */
        if (is_receive_done)
        {
            /* Clear the flag immediately to acknowledge processing */
            is_receive_done = false;

            /*
             * Note: The printing logic below strictly follows the original sample code.
             * It iterates through the buffer based on block index 'j'.
             */
            for (uint8_t j = 0; j < DMA_BLOCK_COUNTER_NUM; j++)
            {
                uint32_t block_offset = j * BYTES_PER_SAMPLE * TRIGGER_SAMPLE_NUM;
                for (uint8_t i = 0; i < TRIGGER_SAMPLE_NUM; i++)
                {
                    uint32_t data_offset = i * BYTES_PER_SAMPLE;
                    DBG_DIRECT("data%d: x:%d, y:%d, z:%d", j * TRIGGER_SAMPLE_NUM + i,
                               i2c_rx_buffer[0 + data_offset + block_offset] | (i2c_rx_buffer[1 + data_offset + block_offset] <<
                                                                                8),
                               i2c_rx_buffer[2 + data_offset + block_offset] | (i2c_rx_buffer[3 + data_offset + block_offset] <<
                                                                                8),
                               i2c_rx_buffer[4 + data_offset + block_offset] | (i2c_rx_buffer[5 + data_offset + block_offset] <<
                                                                                8));
                }
            }
        }
    }

    return 0;
}

/**
 * \brief  Master RX DMA Interrupt Service Routine (ISR).
 */
static void I2C_MASTER_RX_DMA_Handler(void)
{
    DBG_DIRECT("DMA_GetTransferLen %d", DMA_GetTransferLen(I2C_MASTER_RX_DMA_CHANNEL));

    if (DMA_GetINTStatus(I2C_MASTER_RX_DMA_CHANNEL_NUM, DMA_INT_BLOCK_COUNTER) == ENABLE)
    {
        DBG_DIRECT("DMA Block Counter Interrupt");

        /* Notify main loop that this packet is received done */
        is_receive_done = true;

        DMA_ClearAllTypeINT(I2C_MASTER_RX_DMA_CHANNEL_NUM);

        /* Disable triggers to stop reading */
        GPIO_RAPModeCmd(GPIO_IN_PORT, GPIO_IN_PIN, DISABLE);
        DMA_RAPModeCmd(I2C_MASTER_RX_DMA_CHANNEL, DISABLE);
    }
}

/**
 * \brief  GPIO Interrupt Service Routine (ISR).
 */
static void GPIO_Pin_Handler()
{
    /* Mask and disable interrupt */
    GPIO_INTConfig(GPIO_IN_PORT, GPIO_IN_PIN, DISABLE);
    GPIO_MaskINTConfig(GPIO_IN_PORT, GPIO_IN_PIN, ENABLE);

    /*
     * User code can be added here. For example: Print Info.
     * Note: Using "DBG_DIRECT" to printf info in an ISR takes a long time
     * and is not recommended. It is used here solely for demonstration sample.
     */
    DBG_DIRECT("Enter GPIO_Pin_Handler success");

    /* Clear interrupt status */
    GPIO_ClearINTPendingBit(GPIO_IN_PORT, GPIO_IN_PIN);

    /* Unmask and re-enable interrupt */
    GPIO_MaskINTConfig(GPIO_IN_PORT, GPIO_IN_PIN, DISABLE);
    GPIO_INTConfig(GPIO_IN_PORT, GPIO_IN_PIN, ENABLE);
}
```
