## CMakeLists.txt
```
# Copyright (c) 2026 Realtek Semiconductor Corp.
# SPDX-License-Identifier: Apache-2.0

cmake_minimum_required(VERSION 3.20.0)
find_package(Zephyr REQUIRED HINTS $ENV{ZEPHYR_BASE})
project(sensor_rtc_compare_trigger_spi_transfer)

target_include_directories(app PRIVATE ${CMAKE_CURRENT_SOURCE_DIR}/src)
target_sources(app PRIVATE ${CMAKE_CURRENT_SOURCE_DIR}/src/lis3dh_driver.c)
target_sources(app PRIVATE ${CMAKE_CURRENT_SOURCE_DIR}/src/sensor_rtc_compare_trigger_spi_transfer.c)
```

## prj.conf
```kconfig
# Copyright (c) 2026 Realtek Semiconductor Corp.
# SPDX-License-Identifier: Apache-2.0
CONFIG_REALTEK_BEE_PINMUX=y
CONFIG_REALTEK_BEE_RCC=y
CONFIG_REALTEK_BEE_RAP=y
CONFIG_REALTEK_BEE_TIMER=y
CONFIG_REALTEK_BEE_GPIO=y
CONFIG_REALTEK_BEE_DMA=y
CONFIG_REALTEK_BEE_SPI=y
CONFIG_REALTEK_BEE_RTC=y
```

## src/lis3dh_driver.c
```c
/*
 * Copyright (c) 2026, Realtek Semiconductor Corporation
 *
 * SPDX-License-Identifier: LicenseRef-Realtek-5-Clause
 */

/* Includes ------------------------------------------------------------------*/
#include "lis3dh_driver.h"

/* Defines -------------------------------------------------------------------*/

/* Functions -----------------------------------------------------------------*/

/**
 * \brief  Internal helper: Write Register.
 */
static void lis3dh_reg_write(SPI_TypeDef *spi_dev, uint8_t reg, uint8_t value)
{
    /* Prepare Command: Write (RW=0) */
    uint8_t cmd = reg & (~LIS3DH_SPI_RW_BIT);

    /* Use CPU so disable RAP and RX DMA */
    SPI_RAPModeCmd(spi_dev, DISABLE);
    SPI_DMACmd(spi_dev, SPI_DMA_REQ_RX, DISABLE);

    /*
     * SUB[6] is set as 0 in this API.
     * SUB[6] is used to enable address auto increment.
     * If the SUB[6] equals to 1, the SUB[0:6] (register address) is
     * automatically increased to allow multiple data read/writes.
     */

    SPI_SetDirection(spi_dev, SPI_DIRECTION_TXONLY);

    /* TX NDF = 1 (Cmd) + 1 (Data) */
    SPI_WrapModeSetTxNdf(spi_dev, 2);
    SPI_WrapModeResetTxFIFO(spi_dev);
    SPI_SendBuffer(spi_dev, &cmd, 1);
    SPI_SendBuffer(spi_dev, &value, 1);
    SPI_WrapModeStartTx(spi_dev, ENABLE);

    while (SPI_GetFlagState(spi_dev, SPI_FLAG_TFE) == 0) {;}
    while (SPI_GetFlagState(spi_dev, SPI_FLAG_WRAP_CS_EN) == 1) {;}
}

/**
 * \brief  Internal helper: Read Register.
 */
static uint8_t lis3dh_reg_read(SPI_TypeDef *spi_dev, uint8_t reg)
{
    /* Internal buffer for single register reads */
    uint8_t internal_read_buf[16] = {0};

    /* Prepare Command: Read (RW=1) */
    uint8_t cmd = reg | LIS3DH_SPI_RW_BIT;

    /* Use CPU so disable RAP and RX DMA */
    SPI_RAPModeCmd(spi_dev, DISABLE);
    SPI_DMACmd(spi_dev, SPI_DMA_REQ_RX, DISABLE);

    /*
     * SUB[6] is set as 0 in this API.
     * SUB[6] is used to enable address auto increment.
     * If the SUB[6] equals to 1, the SUB[0:6] (register address) is
     * automatically increased to allow multiple data read/writes.
     */

    SPI_SetDirection(spi_dev, SPI_DIRECTION_FULLDUPLEX);

    /* TX NDF = 1 (Cmd) + 1 (Data) */
    SPI_WrapModeSetTxNdf(spi_dev, 2);
    SPI_WrapModeResetTxFIFO(spi_dev);
    SPI_SendBuffer(spi_dev, &cmd, 1);
    SPI_SendBuffer(spi_dev, internal_read_buf, 1); /* Buffer used as dummy source here */
    SPI_WrapModeStartTx(spi_dev, ENABLE);

    while (SPI_GetFlagState(spi_dev, SPI_FLAG_RFNE) == 0) {;}
    while (SPI_GetFlagState(spi_dev, SPI_FLAG_WRAP_CS_EN) == 1) {;}

    /* Read RX FIFO */
    SPI_ReceiveData(spi_dev); /* Discard dummy byte corresponding to command phase */
    return SPI_ReceiveData(spi_dev); /* Return actual data */
}

/**
 * \brief  Configure SPI for Burst Read (RAP Triggered).
 *         Configures the SPI Protocol (NDF, TransferNum) and Enables RAP.
 */
void lis3dh_config_burst_read(SPI_TypeDef *spi_dev, uint8_t reg, uint32_t len)
{
    /* Enable RX DMA Request on SPI side */
    SPI_DMACmd(spi_dev, SPI_DMA_REQ_RX, ENABLE);

    SPI_SetDirection(spi_dev, SPI_DIRECTION_FULLDUPLEX);

    /*
     * TX NDF = len + 1.
     * 1 byte for Command Phase, 'len' bytes for Data Phase.
     */
    SPI_WrapModeSetTxNdf(spi_dev, len + 1);
    SPI_WrapModeResetTxFIFO(spi_dev);
    /* Set Action Parameters */
    SPI_SetActionCmdNum(spi_dev, 1);
    SPI_SetActionTransferNum(spi_dev, len);

    /* Manual Mode: Pre-fill FIFO manually with the Command Byte */
    SPI_SendBuffer(spi_dev, &reg, 1);
}


uint8_t lis3dh_read_id(SPI_TypeDef *spi_dev)
{
    return lis3dh_reg_read(spi_dev, LIS3DH_REG_WHO_AM_I);
}

void lis3dh_config_fifo(SPI_TypeDef *spi_dev, bool enable, uint8_t threshold)
{
    if (enable)
    {
        /* Enable FIFO, Stream Mode, Set Threshold */
        uint8_t fifo_ctrl_reg = lis3dh_reg_read(spi_dev, LIS3DH_REG_FIFO_CTRL_REG);
        fifo_ctrl_reg = (fifo_ctrl_reg & ~0xC0) | (LIS3DH_FIFO_MODE_STREAM_FIFO << 6);
        fifo_ctrl_reg &= ~BIT5;
        fifo_ctrl_reg |= (threshold & 0x1F);
        lis3dh_reg_write(spi_dev, LIS3DH_REG_FIFO_CTRL_REG, fifo_ctrl_reg);

        /* Enable FIFO Mode */
        uint8_t ctrl_reg5 = lis3dh_reg_read(spi_dev, LIS3DH_REG_CTRL_REG5);
        ctrl_reg5 |= BIT6;
        lis3dh_reg_write(spi_dev, LIS3DH_REG_CTRL_REG5, ctrl_reg5);
    }
    else
    {
        /* Configure FIFO mode as Bypass Mode */
        uint8_t fifo_ctrl_reg = lis3dh_reg_read(spi_dev, LIS3DH_REG_FIFO_CTRL_REG);
        fifo_ctrl_reg = (fifo_ctrl_reg & ~0xC0) | (LIS3DH_FIFO_MODE_BYPASS << 6);
        lis3dh_reg_write(spi_dev, LIS3DH_REG_FIFO_CTRL_REG, fifo_ctrl_reg);

        /* Disable FIFO Mode */
        uint8_t ctrl_reg5 = lis3dh_reg_read(spi_dev, LIS3DH_REG_CTRL_REG5);
        ctrl_reg5 &= ~BIT6;
        lis3dh_reg_write(spi_dev, LIS3DH_REG_CTRL_REG5, ctrl_reg5);
    }
}

void lis3dh_config_interrupt(SPI_TypeDef *spi_dev)
{
    /********************* INT1 CFG *********************/
    /*
     * INT1 CFG:
     * 0x30[6:7] AOI-6D is set as '10' means AND combination of interrupt events
     *  - AOI: 1 ~ AND, 0 ~ OR
     *  - 6D : 1  ~Direction Source, 0 ~ Interrupt Source
     * 0x30[0:5] Enable interrupt generation on X(H/L) Y(H/L) Z(H/L)
     */
    lis3dh_reg_write(spi_dev, LIS3DH_REG_INT1_CFG, 0xBF);

    /*
     * INT1 THS:
     * 0x32[0:6] Interrupt threshold support 2^7=128 prescaler of max range.
     */
    lis3dh_reg_write(spi_dev, LIS3DH_REG_INT1_THS, 0x10); /* 1/8 range */

    /*
     * INT1 DURAION:
     * 0x33[0:6] Interrupt Duration.
     */
    lis3dh_reg_write(spi_dev, LIS3DH_REG_INT1_DURATION, 0x01); /* 1 * 1/50 s = 20ms */

    /********************* Click CFG *********************/
    /*
     * CLICK CFG:
     * 0x38[0:5] Enable interrupt single/double click on X(H/L) Y(H/L) Z(H/L)
     */
    lis3dh_reg_write(spi_dev, LIS3DH_REG_CLICK_CFG, 0x15);/* 0x2A is for Double Click */

    /*
     * CLICK SRC:
     * 0x39[0:6] Enable interrupt source
     * - 0x39[0]: X click detection
     * - 0x39[1]: Y click detection
     * - 0x39[2]: Z click detection
     * - 0x39[3]: Click Sign
     * - 0x39[4]: Single Click
     * - 0x39[5]: Double Click
     * - 0x39[6]: Interrupt Active
     */
    //lis3dh_reg_write(spi_dev, LIS3DH_REG_CLICK_SRC, 0x17);

    /*
     * CLICK THS:
     * 0x3A[0:6] Click thresold.
     * This sets the threshold where the click detection process is activated.
     */
    lis3dh_reg_write(spi_dev, LIS3DH_REG_CLICK_THS, 0x0A); /* 1/16 range */

    /*
     * TIME LIMIT:
     * 0x3B[0:6] Click time limit
     * Time acceleration has to fall below threshold for a valid click.
     */
    lis3dh_reg_write(spi_dev, LIS3DH_REG_TIME_LIMIT, 0x08); /* 8 * 1/50 s = 160ms */

    /*
     * TIME LATENCY:
     * 0x3C[0:7] Click time latency
     * hold-off time before allowing detection after click event
     */
    lis3dh_reg_write(spi_dev, LIS3DH_REG_TIME_LATENCY, 0x08); /* 8 * 1/50 s = 160ms */

    /*
     * TIME WINDOWN:
     * 0x3D[0:7] Click time window
     * hold-off time before allowing detection after click event
     */
    lis3dh_reg_write(spi_dev, LIS3DH_REG_TIME_WINDOW, 0x10); /* 16 * 1/50 s = 320ms */

    /********************* Basic CFG *********************/
    /* Clear Latch Interrupt and 4 Direction Detection */
    uint8_t ctrl_reg5 = lis3dh_reg_read(spi_dev, LIS3DH_REG_CTRL_REG5);
    ctrl_reg5 &= ~0x08; /* Do not latch interrupt */
    lis3dh_reg_write(spi_dev, LIS3DH_REG_CTRL_REG5, ctrl_reg5);

    /*
     * CTRL REG3:
     * 0x22[0:7] Interrupt Configure
     * - 0x22[0]: -
     * - 0x22[1]: FIFO Overrun on INT1
     * - 0x22[2]: FIFO Watermack on INT1
     * - 0x22[3]: 3 2 1 DATA ??
     * - 0x22[4]: X Y Z DATA (Data Ready) on INT1
     * - 0x22[5]: IA2 Interrupt on INT1
     * - 0x22[6]: IA1 Interrupt on INT1
     * - 0x22[7]: Click Interrupt on INT1
     */
    uint8_t ctrl_reg3 = 0x60; /* AOI1 | AOI2 */
    lis3dh_reg_write(spi_dev, LIS3DH_REG_CTRL_REG3, ctrl_reg3);

    /*
     * CTRL REG6:
     * 0x25[0:7] Interrupt Configure
     * - 0x25[0]: -
     * - 0x25[1]: INT1 and INT2 pin polarity
     * - 0x25[2]: -
     * - 0x25[3]: Activity Interrupt on INT2
     * - 0x25[4]: Boot on INT2
     * - 0x25[5]: IA2 Interrupt on INT2
     * - 0x25[6]: IA1 Interrupt on INT2
     * - 0x25[7]: Click Interrupt on INT2
     */
    uint8_t ctrl_reg6 = 0x80; /* Click */
    lis3dh_reg_write(spi_dev, LIS3DH_REG_CTRL_REG6, ctrl_reg6);

    /*
     * Overwrite CTRL REG3
     * Matches original code behavior exactly (enabling FIFO Watermark INT on PIN1
     */
    ctrl_reg3 = LIS3DH_I1_WTM;
    lis3dh_reg_write(spi_dev, LIS3DH_REG_CTRL_REG3, ctrl_reg3);
}

void lis3dh_init(SPI_TypeDef *spi_dev)
{
    /*
     * CTRL REG1:
     * 0x20[0:7] Basic Configure
     * - 0x20[0]: X-axis enable
     * - 0x20[1]: Y-axis enable
     * - 0x20[2]: X-axis enable
     * - 0x20[3]: Low Power Mode enable
     * - 0x20[4~7]: Data Rate Selection
     *
     * Enable X Y Z Axis and config Data Rate as 50Hz
     */
    uint8_t ctrl_reg1 = (LIS3DH_DATA_RATE_50_HZ << 4) | 0x07;
    lis3dh_reg_write(spi_dev, LIS3DH_REG_CTRL_REG1, ctrl_reg1);

    /*
     * CTRL REG4:
     * 0x23[0:7] Basic Configure
     * - 0x23[0]: SPI serial interface mode selection
     * - 0x23[1:2]: Self-test enable.
     * - 0x23[3]: High-resolution output mode
     * - 0x23[4:5]: Full-scale selection(00: 2g; 01: 4g; 10: 8g; 11: 16g)
     * - 0x23[6]: Big/little endian data selection.
     * - 0x23[7]: Block data update
     *
     * Use +/- 2g scale, High-resolution, Block data update
     */
    uint8_t ctrl_reg4 = (0x00 << 4) | 0x80 | 0x08;
    lis3dh_reg_write(spi_dev, LIS3DH_REG_CTRL_REG4, ctrl_reg4);

    /* Disable FIFO Mode Firstly */
    lis3dh_config_fifo(spi_dev, DISABLE, 0);
}
```

## src/lis3dh_driver.h
```c
/*
 * Copyright (c) 2026, Realtek Semiconductor Corporation
 *
 * SPDX-License-Identifier: LicenseRef-Realtek-5-Clause
 */

/* Includes ------------------------------------------------------------------*/
#ifndef LIS3DH_H
#define LIS3DH_H

#include <stdint.h>
#include <stdbool.h>
#include "rtl_spi.h"

/* Defines -------------------------------------------------------------------*/

/* LI23DH Parameters */
#define LIS3DH_CHIP_ID                  (0x33)
#define LIS3DH_INT1                     (1)

/* SPI Specific Bits */
#define LIS3DH_SPI_RW_BIT               (1 << 7)
#define LIS3DH_SPI_MS_BIT               (1 << 6)

/* LI23DH Comands */
#define LIS3DH_REG_STATUS_REG_AUX       (0x07)
#define LIS3DH_REG_OUT_ADC1_L           (0x08)
#define LIS3DH_REG_OUT_ADC1_H           (0x09)
#define LIS3DH_REG_OUT_ADC2_L           (0x0A)
#define LIS3DH_REG_OUT_ADC2_H           (0x0B)
#define LIS3DH_REG_OUT_ADC3_L           (0x0C)
#define LIS3DH_REG_OUT_ADC3_H           (0x0D)
#define LIS3DH_REG_WHO_AM_I             (0x0F)
#define LIS3DH_REG_CTRL_REG0            (0x1E)
#define LIS3DH_REG_TEMP_CFG_REG         (0x1F)
#define LIS3DH_REG_CTRL_REG1            (0x20)
#define LIS3DH_REG_CTRL_REG2            (0x21)
#define LIS3DH_REG_CTRL_REG3            (0x22)
#define LIS3DH_REG_CTRL_REG4            (0x23)
#define LIS3DH_REG_CTRL_REG5            (0x24)
#define LIS3DH_REG_CTRL_REG6            (0x25)
#define LIS3DH_REG_REFERENCE            (0x26)
#define LIS3DH_REG_STATUS_REG           (0x27)
#define LIS3DH_REG_OUT_X_L              (0x28)
#define LIS3DH_REG_OUT_X_H              (0x29)
#define LIS3DH_REG_OUT_Y_L              (0x2A)
#define LIS3DH_REG_OUT_Y_H              (0x2B)
#define LIS3DH_REG_OUT_Z_L              (0x2C)
#define LIS3DH_REG_OUT_Z_H              (0x2D)
#define LIS3DH_REG_FIFO_CTRL_REG        (0x2E)
#define LIS3DH_REG_FIFO_SRC_REG         (0x2F)
#define LIS3DH_REG_INT1_CFG             (0x30)
#define LIS3DH_REG_INT1_SRC             (0x31)
#define LIS3DH_REG_INT1_THS             (0x32)
#define LIS3DH_REG_INT1_DURATION        (0x33)
#define LIS3DH_REG_INT2_CFG             (0x34)
#define LIS3DH_REG_INT2_SRC             (0x35)
#define LIS3DH_REG_INT2_THS             (0x36)
#define LIS3DH_REG_INT2_DURATION        (0x37)
#define LIS3DH_REG_CLICK_CFG            (0x38)
#define LIS3DH_REG_CLICK_SRC            (0x39)
#define LIS3DH_REG_CLICK_THS            (0x3A)
#define LIS3DH_REG_TIME_LIMIT           (0x3B)
#define LIS3DH_REG_TIME_LATENCY         (0x3C)
#define LIS3DH_REG_TIME_WINDOW          (0x3D)
#define LIS3DH_REG_ACT_THS              (0x3E)
#define LIS3DH_REG_ACT_DUR              (0x3F)

/* LI23DH FIFO Mode */
#define LIS3DH_FIFO_MODE_BYPASS         (0)
#define LIS3DH_FIFO_MODE_FIFO           (1)
#define LIS3DH_FIFO_MODE_STREAM         (2)
#define LIS3DH_FIFO_MODE_STREAM_FIFO    (3)

/* LI23DH I1 Parameters */
#define LIS3DH_I1_CLICK                 (BIT7)
#define LIS3DH_I1_IA1                   (BIT6)
#define LIS3DH_I1_IA2                   (BIT5)
#define LIS3DH_I1_ZYXDA                 (BIT4)
#define LIS3DH_I1_321DA                 (BIT3)
#define LIS3DH_I1_WTM                   (BIT2)
#define LIS3DH_I1_OVERRUN               (BIT1)

/* LI23DH Data Rate Parameters */
#define LIS3DH_DATA_RATE_5376_HZ        (9)
#define LIS3DH_DATA_RATE_1600_HZ        (8)
#define LIS3DH_DATA_RATE_400_HZ         (7)
#define LIS3DH_DATA_RATE_200_HZ         (6)
#define LIS3DH_DATA_RATE_100_HZ         (5)
#define LIS3DH_DATA_RATE_50_HZ          (4)
#define LIS3DH_DATA_RATE_25_HZ          (3)
#define LIS3DH_DATA_RATE_10_HZ          (2)
#define LIS3DH_DATA_RATE_1_HZ           (1)
#define LIS3DH_DATA_RATE_POWER_DOWN     (0)

/* Functions -----------------------------------------------------------------*/

/**
 * \brief  Initialize LIS3DH (ODR, Range, BDU).
 * \param  spi_dev: SPI Peripheral instance.
 */
void lis3dh_init(SPI_TypeDef *spi_dev);

/**
 * \brief  Read Device ID.
 * \return ID (0x33).
 */
uint8_t lis3dh_read_id(SPI_TypeDef *spi_dev);

/**
 * \brief  Configure Sensor Interrupts (Threshold, Click, etc.).
 * \param  spi_dev: SPI Peripheral instance.
 */
void lis3dh_config_interrupt(SPI_TypeDef *spi_dev);

/**
 * \brief  Configure FIFO mode.
 */
void lis3dh_config_fifo(SPI_TypeDef *spi_dev, bool enable, uint8_t threshold);

/**
 * \brief  Configure Burst Read for SPI.
 *         Note: This only configures the SPI Protocol (NDF, RAP Mode).
 *         The Application is responsible for setting up DMA TX/RX.
 */
void lis3dh_config_burst_read(SPI_TypeDef *spi_dev, uint8_t reg, uint32_t len);

#endif /* LIS3DH_H */
```

## src/sensor_rtc_compare_trigger_spi_transfer.c
```c
/*
 * Copyright (c) 2026, Realtek Semiconductor Corporation
 *
 * SPDX-License-Identifier: LicenseRef-Realtek-5-Clause
 */

/*============================================================================*
 *                              Header Files
 *============================================================================*/
#include <stdlib.h>
#include <stdint.h>
#include "rtl_pinmux.h"
#include "rtl_rcc.h"
#include "rtl_nvic.h"
#include "rtl_rap.h"
#include "rtl_timer.h"
#include "rtl_gpio.h"
#include "rtl_dma.h"
#include "rtl_spi.h"
#include "rtl_rtc.h"
#include "utils.h"
#include "log_core.h"
#include "lis3dh_driver.h"

/* Defines ------------------------------------------------------------*/
/* RTC configuration which can be modified based on requirements */
/*
 * Configure RTC Prescaler parameters.
 *
 * Calculation formula:
 *  - Tick_Freq = Clock_Src(32kHz) / (PSC + 1).
 *
 * Based on the following settings:
 *  - RTC Clock Source: 32kHz.
 *
 * Define the RTC_PSC_VALUE as (320 - 1) which generates a 10kHz(10ms) tick.
 */
#define RTC_PRESCALER_VALUE                 (320 - 1)

/*
 * Configure RTC Compare and Reload parameters.
 *
 * Calculation formula:
 *  - Timeout = Value * (1 / Tick_Freq).
 *
 * Based on the following settings:
 *  - RTC Tick Frequency: 100Hz (from Prescaler settings).
 *
 * Define RTC_COMP_VALUE as 20 which timeout is 200ms.
 * Define RTC_COMP_RELOAD_VALUE as 10 which reload time is 100ms.
 */
#define RTC_COMP_NUM                        RTC_COMP0
#define RTC_COMP_INT                        RTC_INT_COMP0
#define RTC_COMP_VALUE                      10
#define RTC_COMP_RELOAD_VALUE               10

/* RAP Configuration */
#define RTC_EVENT_COMPARE                   RAP_EVENT_RTC_COMPARE(0)

/* SPI configuration which can be modified based on requirements */
#define SPI_MASTER                          SPI0
#define SPI_MASTER_CLOCK                    SPI0_CLOCK
#define SPI_MASTER_SCK_PIN                  P4_0
#define SPI_MASTER_MOSI_PIN                 P4_1
#define SPI_MASTER_MISO_PIN                 P4_2
#define SPI_MASTER_CS_PIN                   P4_3
#define SPI_MASTER_CLK_PINMUX               SPI0_CLK_MASTER
#define SPI_MASTER_MO_PINMUX                SPI0_MO_MASTER
#define SPI_MASTER_MI_PINMUX                SPI0_MI_MASTER
#define SPI_MASTER_CS_PINMUX                SPI0_SS_N_0_MASTER

/* RAP Configuration */
#define SPI_MASTER_EVENT_TRANSFER_START     RAP_EVENT_SPI_START(0)
#define SPI_MASTER_ACTION_TRANSFER_START    RAP_ACTION_SPI_START(0)

/* DMA configuration which can be modified based on requirements */
/* Master RX DMA */
#define SPI_MASTER_RX_DMA_CHANNEL           DMA_CH4
#define SPI_MASTER_RX_DMA_CHANNEL_NUM       DMA_CH_NUM4
#define SPI_MASTER_RX_DMA_IRQN              DMA0_CH4_IRQn
#define SPI_MASTER_RX_DMA_HANDSHAKE         DMA_HANDSHAKE_SPI0_RX

/* RAP Configuration */
#define SPI_MASTER_RX_DMA_ACTION_START      RAP_ACTION_DMA_CHANNEL_EN(4)

/*
 * 3 Axis includes X, Y, Z.
 * 12-bit data out per Axis in high resolution mode (2 bytes).
 */
#define BYTES_PER_SAMPLE                    (3 * 2)

/*
 * Number of sets to read in one trigger.
 * In Periodic mode, we usually read 1 sample set per RTC trigger.
 */
#define TRIGGER_SAMPLE_NUM                  (1)

/* DMA Block Counter (Interrupt triggers after this many blocks) */
#define DMA_BLOCK_COUNTER_NUM               (10)

/* Globals ------------------------------------------------------------------*/
/*
 * SPI RX Buffer Size Calculation:
 * In Full Duplex Mode, for every transaction set:
 * 1 Byte (Command Phase) + N Bytes (Data Phase).
 * Buffer stores 'DMA_BLOCK_COUNTER_NUM' history of samples.
 */
static uint8_t spi_rx_buffer[(1 + BYTES_PER_SAMPLE * TRIGGER_SAMPLE_NUM) * DMA_BLOCK_COUNTER_NUM] = {0};
static volatile bool is_receive_done = false;

/* Functions ----------------------------------------------------------------*/
/**
 * \brief  DMA Interrupt Service Routine (ISR) prototype for SPI Master RX.
 */
static void SPI_MASTER_RX_DMA_Handler(void);

/**
 * \brief  RTC Interrupt Service Routine (ISR) prototype.
 */
static void RTC_Handler(void);

/**
 * \brief  Initialize SPI Master pad and pinmux settings.
 */
static void board_spi_master_init(void)
{
    Pad_Config(SPI_MASTER_SCK_PIN, PAD_PINMUX_MODE, PAD_IS_PWRON, PAD_PULL_UP, PAD_OUT_ENABLE,
               PAD_OUT_HIGH);
    Pad_Config(SPI_MASTER_MOSI_PIN, PAD_PINMUX_MODE, PAD_IS_PWRON, PAD_PULL_UP, PAD_OUT_ENABLE,
               PAD_OUT_HIGH);
    Pad_Config(SPI_MASTER_MISO_PIN, PAD_PINMUX_MODE, PAD_IS_PWRON, PAD_PULL_UP, PAD_OUT_ENABLE,
               PAD_OUT_HIGH);
    Pad_Config(SPI_MASTER_CS_PIN, PAD_PINMUX_MODE, PAD_IS_PWRON, PAD_PULL_UP, PAD_OUT_ENABLE,
               PAD_OUT_HIGH);

    Pinmux_Config(SPI_MASTER_SCK_PIN, SPI_MASTER_CLK_PINMUX);
    Pinmux_Config(SPI_MASTER_MOSI_PIN, SPI_MASTER_MO_PINMUX);
    Pinmux_Config(SPI_MASTER_MISO_PIN, SPI_MASTER_MI_PINMUX);
    Pinmux_Config(SPI_MASTER_CS_PIN, SPI_MASTER_CS_PINMUX);
}

/**
 * \brief  Initialize SPI Master peripheral.
 */
static void driver_spi_master_init(void)
{
    /* Enable SPI Master clock */
    SPI_DeInit(SPI_MASTER);
    RCC_ClockCmd(SPI_MASTER_CLOCK, ENABLE);

    /* Configure SPI Master parameters */
    SPI_InitTypeDef  SPI_InitStruct;
    SPI_StructInit(&SPI_InitStruct);
    SPI_InitStruct.SPI_Direction         = SPI_DIRECTION_FULLDUPLEX;
    SPI_InitStruct.SPI_Mode              = SPI_MODE_MASTER;
    SPI_InitStruct.SPI_DataSize          = SPI_DATA_SIZE_8b;
    SPI_InitStruct.SPI_CPOL              = SPI_CPOL_LOW;
    SPI_InitStruct.SPI_CPHA              = SPI_CPHA_1EDGE;
    SPI_InitStruct.SPI_FrameFormat       = SPI_FRAME_MOTOROLA;
    SPI_InitStruct.SPI_BaudRatePrescaler = 100;
    SPI_InitStruct.SPI_WrapModeEn        = ENABLE;
    SPI_InitStruct.SPI_TXNDF             = 8;
    SPI_InitStruct.SPI_RxDMAEn           = DISABLE; /* Enable when needed */
    SPI_InitStruct.SPI_RxWaterlevel      = 1 - 1;
    SPI_InitStruct.SPI_RxThresholdLevel  = 2;
    /* Manual Mode: WrapModeDMAEn is DISABLE (Default) */
    SPI_Init(SPI_MASTER, &SPI_InitStruct);

    /* Enable SPI */
    SPI_Cmd(SPI_MASTER, ENABLE);
}

/**
 * \brief  Initialize DMA Channel for Master RX.
 */
static void driver_dma_master_rx_init(void)
{
    /* Enable DMA clock */
    RCC_ClockCmd(DMA_CLOCK, ENABLE);

    /* Configure DMA parameters */
    DMA_InitTypeDef DMA_InitStruct;
    DMA_StructInit(&DMA_InitStruct);
    DMA_InitStruct.DMA_ChannelNum          = SPI_MASTER_RX_DMA_CHANNEL_NUM;
    DMA_InitStruct.DMA_Direction           = DMA_DIR_PERIPHERAL_TO_MEMORY;
    DMA_InitStruct.DMA_BufferSize          = 0; /* To be configured later */
    DMA_InitStruct.DMA_SourceInc           = DMA_SOURCE_FIX;
    DMA_InitStruct.DMA_DestinationInc      = DMA_DESTINATION_INC;
    DMA_InitStruct.DMA_SourceDataSize      = DMA_DATA_SIZE_BYTE;
    DMA_InitStruct.DMA_DestinationDataSize = DMA_DATA_SIZE_BYTE;
    DMA_InitStruct.DMA_SourceMsize         = DMA_MSIZE_1;
    DMA_InitStruct.DMA_DestinationMsize    = DMA_MSIZE_1;
    DMA_InitStruct.DMA_SourceAddr          = (uint32_t)SPI_MASTER->SPI_DR;
    DMA_InitStruct.DMA_DestinationAddr     = (uint32_t)NULL;
    DMA_InitStruct.DMA_SourceHandshake     = SPI_MASTER_RX_DMA_HANDSHAKE;
    DMA_Init(SPI_MASTER_RX_DMA_CHANNEL, &DMA_InitStruct);

    /* Update vector table with ISR */
    ram_vector_table_update(SPI_MASTER_RX_DMA_IRQN, SPI_MASTER_RX_DMA_Handler);

    /* Configure NVIC */
    NVIC_InitTypeDef NVIC_InitStruct;
    NVIC_InitStruct.NVIC_IRQChannel         = SPI_MASTER_RX_DMA_IRQN;
    NVIC_InitStruct.NVIC_IRQChannelCmd      = ENABLE;
    NVIC_InitStruct.NVIC_IRQChannelPriority = 2;
    NVIC_Init(&NVIC_InitStruct);

    /* Enable DMA Block Counter interrupt */
    DMA_INTConfig(SPI_MASTER_RX_DMA_CHANNEL_NUM, DMA_INT_BLOCK_COUNTER, ENABLE);
}

/**
 * \brief  Initialize RTC for Periodic Trigger.
 */
static void driver_rtc_init(void)
{
    /* Enable RTC clock */
    RCC_ClockCmd(RTC_CLOCK, ENABLE);
    RTC_DeInit();

    /* Configure RTC prescaler to generate the tick */
    RTC_SetPrescaler(RTC_PRESCALER_VALUE);

    /* Configure RTC compare and reload value */
    RTC_EnableCompAutoReload(RTC_COMP_NUM, RTC_COMP_VALUE, RTC_COMP_RELOAD_VALUE);

    /* Reset the RTC counter to ensure the initial timing starts from zero */
    RTC_ResetCounter();

#if 0
    /* Update vector table with ISR */
    ram_vector_table_update(RTC_IRQn, RTC_Handler);

    /* Configure NVIC */
    NVIC_InitTypeDef NVIC_InitStruct;
    NVIC_InitStruct.NVIC_IRQChannel         = RTC_IRQn;
    NVIC_InitStruct.NVIC_IRQChannelCmd      = ENABLE;
    NVIC_InitStruct.NVIC_IRQChannelPriority = 3;
    NVIC_Init(&NVIC_InitStruct);

    /* Enable RTC interrupt */
    RTC_NVICCmd(ENABLE);
    RTC_INTConfig(RTC_COMP_INT, ENABLE);
#endif
}

/**
 * \brief  Main entry.
 */
int main(void)
{
    /* Enable Global Interrupts */
    __enable_irq();

    DBG_DIRECT("Start Sensor RTC trigger spi transfer sample");

    /* Peripheral initialization */
    board_spi_master_init();
    driver_spi_master_init();
    driver_dma_master_rx_init();
    driver_rtc_init();

    /* Initialize Sensor */
    lis3dh_init(SPI_MASTER);

    /* Read ID */
    uint8_t id = lis3dh_read_id(SPI_MASTER);
    DBG_DIRECT("Sensor ID: 0x%02x", id);

    /* Configure Sensor FIFO */
    lis3dh_config_fifo(SPI_MASTER, DISABLE, 0);

    /* Configure RAP channel */
    uint8_t channel0, channel1;
    RAP_ChannelAllocate(&channel0);
    RAP_ChannelAllocate(&channel1);

    /* RTC Compare event trigger SPI transfer start */
    RAP_EventRouteSet(RTC_EVENT_COMPARE, channel0);
    RAP_ActionBindSet(SPI_MASTER_ACTION_TRANSFER_START, channel0);

    /* SPI transfer start event trigger RX DMA start */
    RAP_EventRouteSet(SPI_MASTER_EVENT_TRANSFER_START, channel1);
    RAP_ActionBindSet(SPI_MASTER_RX_DMA_ACTION_START, channel1);

    /*
     * Configure Burst Read Protocol
     * Prepare Command Byte (Read | MS | Addr)
     * Calculate total transfer length: 1 cmd byte + Data Bytes
     * Manual Mode: Driver will fill TX FIFO once.
     */
    uint8_t cmd = LIS3DH_REG_OUT_X_L | LIS3DH_SPI_RW_BIT | LIS3DH_SPI_MS_BIT;
    lis3dh_config_burst_read(SPI_MASTER, cmd, TRIGGER_SAMPLE_NUM * BYTES_PER_SAMPLE);

    /* Configure RX DMA to receive (Dummy + Data) */
    DMA_SetBufferSize(SPI_MASTER_RX_DMA_CHANNEL, TRIGGER_SAMPLE_NUM * BYTES_PER_SAMPLE + 1);
    DMA_SetDestinationAddress(SPI_MASTER_RX_DMA_CHANNEL, (uint32_t)spi_rx_buffer);
    DMA_SetBlockCounter(SPI_MASTER_RX_DMA_CHANNEL, DMA_BLOCK_COUNTER_NUM);
    DMA_ContDarCmd(SPI_MASTER_RX_DMA_CHANNEL, ENABLE);

    /* Enable RAP Mode */
    RTC_RAPModeCmd(ENABLE);
    SPI_RAPModeCmd(SPI_MASTER, ENABLE);
    DMA_RAPModeCmd(SPI_MASTER_RX_DMA_CHANNEL, ENABLE);

    /* Start RTC Trigger */
    RTC_ActionTrigger(RTC_ACTION_START);

    while (1)
    {
        /*
         * Check data reception status.
         * The 'is_dma_receive_done' flag is set in the DMA ISR (Block Counter Interrupt).
         * Block Counter Interrupt is triggered indicates a batch of data received.
         */
        if (is_receive_done)
        {
            /* Clear the flag immediately to acknowledge processing */
            is_receive_done = false;

            for (uint8_t j = 0; j < DMA_BLOCK_COUNTER_NUM; j++)
            {
                /*
                 * Indexing Correction for SPI Periodic Mode:
                 * Each trigger reads 1 set of data (6 bytes).
                 * Block Size = 1 (Dummy) + 6 (Data).
                 * Data Start = BlockOffset.
                 */
                uint32_t data_offset = j * (BYTES_PER_SAMPLE * TRIGGER_SAMPLE_NUM + 1) + 1;

                DBG_DIRECT("data%d: x:%d, y:%d, z:%d", j,
                           spi_rx_buffer[data_offset + 0] | (spi_rx_buffer[data_offset + 1] << 8),
                           spi_rx_buffer[data_offset + 2] | (spi_rx_buffer[data_offset + 3] << 8),
                           spi_rx_buffer[data_offset + 4] | (spi_rx_buffer[data_offset + 5] << 8));
            }
        }
    }

    return 0;
}

static void SPI_MASTER_RX_DMA_Handler(void)
{
    DBG_DIRECT("dma rx handler");

    if (DMA_GetINTStatus(SPI_MASTER_RX_DMA_CHANNEL_NUM, DMA_INT_BLOCK_COUNTER) == ENABLE)
    {
        DBG_DIRECT("DMA Block Counter Interrupt");

        /* Notify main loop that this packet is received done */
        is_receive_done = true;

        DMA_ClearAllTypeINT(SPI_MASTER_RX_DMA_CHANNEL_NUM);

        /* Stop Triggers */
        RTC_ActionTrigger(RTC_ACTION_STOP);
        RTC_RAPModeCmd(DISABLE);
        DMA_RAPModeCmd(SPI_MASTER_RX_DMA_CHANNEL, DISABLE);
    }
}

/**
 * \brief  RTC Interrupt Service Routine (ISR).
 */
static void RTC_Handler(void)
{
    if (RTC_GetINTStatus(RTC_COMP_INT) == SET)
    {
        DBG_DIRECT("RTC_HANDLER: RTC_COMP_NUM_INT");
        RTC_ClearCompINT(RTC_COMP_NUM);
    }
}
```
