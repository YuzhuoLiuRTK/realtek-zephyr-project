/*
 * Copyright (c) 2026, Realtek Semiconductor Corporation
 *
 * SPDX-License-Identifier: Apache-2.0
 */

/* Give MCUboot the same partition layout as the application. This replaces
 * MCUboot's own app.overlay, so its code-partition choice is repeated here.
 */
#include "../boards/rtl87x2j_evb_rtl8762jth.overlay"

/ {
	chosen {
		zephyr,code-partition = &boot_partition;
	};
};
