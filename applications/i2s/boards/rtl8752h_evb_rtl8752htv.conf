## applications/i2s/boards/rtl8752h_evb_rtl8752htv.conf
```kconfig
# each pingpong buffer will malloc 2 BLOCK_SIZE buffer
CONFIG_HEAP_MEM_POOL_SIZE=2048
CONFIG_AUDIO=y
CONFIG_AUDIO_CODEC=y
CONFIG_I2S=y
CONFIG_BOOT_BANNER=n
CONFIG_I2S_BEE_RX=y
CONFIG_I2S_BEE_TX=y
```

## applications/i2s/boards/rtl8762gn_evb.conf
```kconfig
# each pingpong buffer will malloc 2 BLOCK_SIZE buffer
CONFIG_HEAP_MEM_POOL_SIZE=2048
CONFIG_AUDIO=y
CONFIG_AUDIO_CODEC=y
CONFIG_I2S=y
CONFIG_BOOT_BANNER=n
CONFIG_I2S_RTL87X2G_RX=y
CONFIG_I2S_RTL87X2G_TX=y
```

## applications/pm_device_test/boards/rtl8752htv_evb.conf
```kconfig
CONFIG_HEAP_MEM_POOL_SIZE=1024
CONFIG_SHELL=y
CONFIG_PM=y
CONFIG_PM_DEVICE=y
# CONFIG_LOG=y
# CONFIG_REALTEK_BEE_PM=y
CONFIG_LOG=y
CONFIG_LOG_PRINTK=y
CONFIG_LOG_MODE_DEFERRED=y
# 
CONFIG_SERIAL=y
CONFIG_GPIO=y
CONFIG_DMA=y
CONFIG_COUNTER=y
CONFIG_PWM=y
CONFIG_SPI=y
CONFIG_RTC=y
CONFIG_I2C=y
CONFIG_RTC_RTL8752H=y
CONFIG_RTC_ALARM=y
CONFIG_RTC_UPDATE=y
CONFIG_INPUT=y
CONFIG_INPUT_EVENT_DUMP=y
CONFIG_INPUT_RTL8752H_KSCAN=y
CONFIG_RTL8752H_KEYSCAN_AUTOSCAN_MODE=n
CONFIG_ADC=y
CONFIG_ADC_ASYNC=y

# CONFIG_SENSOR=y
```

## applications/pm_device_test/boards/rtl8762gn_evb.conf
```kconfig
CONFIG_HEAP_MEM_POOL_SIZE=1024
CONFIG_SHELL=y
CONFIG_PM=y
CONFIG_PM_DEVICE=y
# CONFIG_LOG=y
# CONFIG_REALTEK_BEE_PM=y
CONFIG_LOG=y
CONFIG_LOG_PRINTK=y
CONFIG_LOG_MODE_DEFERRED=y
# 
CONFIG_SERIAL=y
CONFIG_GPIO=y
CONFIG_DMA=y
CONFIG_COUNTER=y
CONFIG_PWM=y
CONFIG_SPI=y
CONFIG_RTC=y
CONFIG_I2C=y
CONFIG_RTC_RTL87X2G=y
CONFIG_RTC_ALARM=y
CONFIG_RTC_UPDATE=y
CONFIG_SENSOR=y
CONFIG_INPUT=y
CONFIG_INPUT_EVENT_DUMP=y
CONFIG_INPUT_RTL87X2G_KSCAN=y
CONFIG_RTL87X2G_INPUT_KEYSCAN_AUTOSCAN_MODE=y
CONFIG_ADC=y
CONFIG_ADC_ASYNC=y

# CONFIG_USB_DEVICE_STACK_NEXT=y

# CONFIG_CAN=y
# CONFIG_CAN_SHELL=y
# CONFIG_CAN_STATS=y
```

## samples/drivers/i2s/sample.yaml
```yaml
sample:
  description: i2s sample, the simplest Zephyr
    application
  name: i2s
common:
  tags: introduction
  integration_platforms:
    - native_posix
  harness: console
  harness_config:
    type: one_line
    regex:
      - "i2s! (.*)"
tests:
  sample.basic.i2s:
    tags: introduction
```
